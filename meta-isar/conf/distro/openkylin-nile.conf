## meta-isar/conf/distro/openkylin-nile.conf
```bitbake
#
# Copyright (c) Siemens AG, 2018-2023
#
# SPDX-License-Identifier: MIT

#require conf/distro/debian-common.conf

BASE_DISTRO = "openkylin"

HOST_DISTRO ?= "debian-bookworm"

BASE_DISTRO_CODENAME = "nile"

DISTRO_APT_SOURCES ?= "conf/distro/${BASE_DISTRO}-${BASE_DISTRO_CODENAME}.list"
HOST_DISTRO_APT_SOURCES ?= "conf/distro/${HOST_DISTRO}.list"

BOOTSTRAP_KEY = "file://${LAYERDIR_isar}/conf/distro/openkylin.public.key;sha256sum=36a38199a4bf4eae1e7f574891f7dfcb79b91b87a33a499383265e1224b5e989"
DISTRO_BOOTSTRAP_KEYS += "${BOOTSTRAP_KEY}"
HOST_DISTRO_BOOTSTRAP_KEYS += "${BOOTSTRAP_KEY}"

DISTRO_DEBOOTSTRAP_SCRIPT = "/usr/share/debootstrap/scripts/gutsy"

KERNEL_NAME = "generic"

SYSTEMD_BOOTLOADER_INSTALL = "systemd:${DISTRO_ARCH}"

GRUB_BOOTLOADER_INSTALL:amd64 = "grub-efi-amd64-bin"

GRUB_DEBIAN_SB_CHAIN:amd64 = "grub-efi-amd64-signed shim-signed"
GRUB_DEBIAN_SB_MOK:amd64 = "shim-helpers-amd64-signed"

SYSLINUX_BOOTLOADER_INSTALL = "syslinux syslinux-common"

DISTRO_BOOTSTRAP_BASE_PACKAGES:append = " usrmerge openkylin-archive-anything"

DISTRO_KERNELS ?= "platform industry phytium lotus2 visionfive2 rockchip raspberrypi vf2-ok generic"

IMAGER_INSTALL:wic += "parted \
                       gdisk \
                       util-linux \
                       dosfstools \
                       mtools \
                       e2fsprogs \
                       bmap-tools \
                       tar \
                       python3-distutils \
                       fdisk"

IMAGE_PREINSTALL += "init"
IMAGE_PREINSTALL += "initramfs-tools"

DISTRO_GCC = "12"

DEBIAN_COMPAT = "13"
```
